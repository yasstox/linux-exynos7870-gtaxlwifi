## Documentation/devicetree/bindings/display/panel/synaptics,tddi.yaml
```yaml
# SPDX-License-Identifier: (GPL-2.0-only OR BSD-2-Clause)
%YAML 1.2
---
$id: http://devicetree.org/schemas/display/panel/samsung,tddi.yaml#
$schema: http://devicetree.org/meta-schemas/core.yaml#

title: Synaptics TDDI Display Panel Controller

maintainers:
  - Kaustabh Chakraborty <kauschluss@disroot.org>

allOf:
  - $ref: panel-common.yaml#

properties:
  compatible:
    enum:
      - syna,td4101-panel
      - syna,td4300-panel

  reg:
    maxItems: 1

  backlight-gpios:
    maxItems: 1
    description: Backlight enable GPIO

  width-mm: true
  height-mm: true
  panel-timing: true

required:
  - compatible
  - reg
  - width-mm
  - height-mm
  - panel-timing

additionalProperties: false

examples:
  - |
    dsi {
        #address-cells = <1>;
        #size-cells = <0>;

        panel@0 {
            compatible = "synaptics,td4300-panel";
            reg = <0>;

            backlight-gpios = <&gpd3 5 GPIO_ACTIVE_LOW>;

            width-mm = <68>;
            height-mm = <121>;

            panel-timing {
                clock-frequency = <144389520>;

                hactive = <1080>;
                hsync-len = <4>;
                hfront-porch = <120>;
                hback-porch = <32>;

                vactive = <1920>;
                vsync-len = <2>;
                vfront-porch = <21>;
                vback-porch = <4>;
            };
        };
    };

...
```

## Documentation/devicetree/bindings/extcon/samsung,s2m-muic.yaml
```yaml
# SPDX-License-Identifier: (GPL-2.0-only OR BSD-2-Clause)
%YAML 1.2
---
$id: http://devicetree.org/schemas/extcon/samsung,s2m-muic.yaml#
$schema: http://devicetree.org/meta-schemas/core.yaml#

title: Extcon Driver for Samsung S2M series PMICs

maintainers:
  - Kaustabh Chakraborty <kauschluss@disroot.org>

description: |
  The Samsung S2M series PMIC extcon device is a USB port accessory
  detector. It reports multiple states depending on the ID-GND
  resistance measured by an internal ADC.

  This is a part of device tree bindings for S2M and S5M family of Power
  Management IC (PMIC).

  See also Documentation/devicetree/bindings/mfd/samsung,s2mps11.yaml for
  additional information and example.

properties:
  compatible:
    enum:
      - samsung,s2mu005-muic

  ports:
    $ref: /schemas/graph.yaml#/properties/ports
    description:
      Any connector to the data bus of this controller should be modelled using
      the OF graph bindings specified
    properties:
      port:
        $ref: /schemas/graph.yaml#/properties/port
    required:
      - port

required:
  - compatible
  - ports

additionalProperties: false
```
